## main/Kconfig.main
```kconfig
menu "Pin layout"
    config PIN_LED
        int "On Board LED GPIO Num WS2812B"
        range ENV_GPIO_RANGE_MIN ENV_GPIO_OUT_RANGE_MAX
        default 8
        help
            GPIO number for Led that App will use as UI.
    
    config PIN_BUTTON
        int "On Board Button GPIO Num"
        range ENV_GPIO_RANGE_MIN ENV_GPIO_OUT_RANGE_MAX
        default 9
        help
            GPIO number for the button that App will use as UI.
    
endmenu
```

## main/Kconfig.projbuild
```kconfig
menu "Project Settings"
    
    orsource "$IDF_PATH/examples/common_components/env_caps/$IDF_TARGET/Kconfig.env_caps"

    rsource "./Kconfig.main"
    rsource "./../components/matter/Kconfig.matter"

    comment "Module Debugging"

    
endmenu
```
